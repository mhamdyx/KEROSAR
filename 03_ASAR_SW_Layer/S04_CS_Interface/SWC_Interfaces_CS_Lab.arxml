AUTOSAR XML (schema 00051)
package /CS_Interface_Lab
  client server interface CSI_sum
    operation OP_sum
      arg in1: type=uint16, direction=IN
      arg in2: type=uint16, direction=IN
      arg out: type=uint32, direction=OUT
  application sw component type SWC1_Server
    provide port PP_CS_sum: client-server-annotation=OP_sum
  application sw component type SWC2_Client
    require port RP_CS_sum: client-server-annotation=OP_sum
