AUTOSAR XML (schema 00051)
package /SWCs_EABS_Package
  sensor actuator sw component type LidarSensor_SAC_SWC1
  sensor actuator sw component type SpeedSensor_SAC_SWC2
  ecu abstraction sw component type IO_ECUAbstr_SWC3
  application sw component type EABS_App_SWC4
  parameter sw component type d_P_SWC5
  sensor actuator sw component type LEDWarning_SAC_SWC6
  complex device driver sw component type Brake_CDD_SWC7
  service sw component type DiagM_Service_SWC8
  nv block sw component type Flash_NVBLK_SWC9
