AUTOSAR XML (schema 00051)
package /Interfaces
  sender receiver interface IF_SR_LidarData
    data LidarSensor: type=uint32
